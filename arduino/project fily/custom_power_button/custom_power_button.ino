/**************************************************************************
  This is an example for our Monochrome OLEDs based on SSD1306 drivers

  Pick one up today in the adafruit shop!
  ------> http://www.adafruit.com/category/63_98

  This example is for a 128x32 pixel display using I2C to communicate
  3 pins are required to interface (two I2C and one reset).

  Adafruit invests time and resources providing this ;open
  source code, please support Adafruit and open-source
  hardware by purchasing products from Adafruit!

  Written by Limor Fried/Ladyada for Adafruit Industries,
  with contributions from the open source community.
  BSD license, check license.txt for more information
  All text above, and the splash screen below must be
  included in any redistribution.
 **************************************************************************/

#include <Wire.h>
#include <Adafruit_GFX.h>
#include <Adafruit_SSD1306.h>

#define SCREEN_WIDTH 128 // OLED display width, in pixels
#define SCREEN_HEIGHT 32 // OLED display height, in pixels

// Declaration for an SSD1306 display connected to I2C (SDA, SCL pins)
// The pins for I2C are defined by the Wire-library.
// On an arduino UNO:       A4(SDA), A5(SCL)
// On an arduino MEGA 2560: 20(SDA), 21(SCL)
// On an arduino LEONARDO:   2(SDA),  3(SCL), ...
#define OLED_RESET     -1 // Reset pin # (or -1 if sharing Arduino reset pin)
#define SCREEN_ADDRESS 0x3C ///< See datasheet for Address; 0x3D for 128x64, 0x3C for 128x32
Adafruit_SSD1306 display(SCREEN_WIDTH, SCREEN_HEIGHT, &Wire, OLED_RESET);

// #define NUMFLAKES     10 // Number of snowflakes in the animation example

#define LOGO_HEIGHT   16
#define LOGO_WIDTH    16

#define SERIAL_BUFFER_SIZE 16

static const unsigned char big_chester [] PROGMEM = {
  0x00, 0x00, 0x00, 0x00, 0x00, 0x00, 0x00, 0x00, 0x00, 0x00, 0x01, 0xe0, 0x07, 0x80, 0x00, 0x02,
  0x1f, 0xf8, 0x40, 0x00, 0x02, 0xd0, 0x0b, 0x40, 0x00, 0x02, 0xd0, 0x0b, 0x40, 0x00, 0x02, 0x10,
  0x08, 0x60, 0x00, 0x05, 0xe0, 0x07, 0x98, 0x00, 0x08, 0x00, 0x00, 0x04, 0x00, 0x10, 0x00, 0x00,
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  0x00, 0x18, 0x00, 0x3e, 0x40, 0x00, 0x00, 0x00, 0x01, 0x80, 0x00, 0x00, 0x00, 0x00, 0x00, 0x00
};

const unsigned char amogus [][20] PROGMEM = {
  {
    0x00, 0x00, 0x7e, 0x00, 0x91, 0x00, 0xa1, 0x00, 0x40, 0x80, 0x40, 0x80, 0x26, 0x80, 0x19, 0x00,
    0x10, 0x00, 0x00, 0x00
  },
  {
    0x07, 0x00, 0x78, 0x80, 0xa0, 0x40, 0xc0, 0x40, 0x40, 0x40, 0x20, 0x40, 0x22, 0x80, 0x15, 0x00,
    0x18, 0x00, 0x00, 0x00
  },
  {
    0x00, 0x00, 0x7e, 0x00, 0x89, 0x80, 0x90, 0x40, 0xe0, 0x40, 0x20, 0x40, 0x20, 0x80, 0x17, 0x00,
    0x18, 0x00, 0x00, 0x00
  },
  {
    0x00, 0x00, 0x38, 0x00, 0x47, 0x00, 0x48, 0x80, 0x50, 0x40, 0x20, 0x40, 0x20, 0x40, 0x20, 0x80,
    0x1f, 0x00, 0x00, 0x00
  },
  {
    0x00, 0x00, 0x3c, 0x00, 0x47, 0x00, 0xbc, 0x80, 0x40, 0x40, 0x40, 0x80, 0x40, 0x80, 0x67, 0x00,
    0x18, 0x00, 0x00, 0x00
  },
  {
    0x00, 0x00, 0x3e, 0x00, 0xe1, 0x00, 0xc0, 0x80, 0x40, 0x80, 0x40, 0x80, 0x22, 0x80, 0x25, 0x00,
    0x18, 0x00, 0x00, 0x00
  }
};

const unsigned char nano [] PROGMEM = {
  // 'NANO, 11x18px
  0x1f, 0x00, 0xf1, 0xe0, 0x8e, 0x20, 0xa0, 0xa0, 0x80, 0x20, 0xa0, 0xa0, 0x80, 0x20, 0xa0, 0xa0,
  0x80, 0x20, 0xa0, 0xa0, 0x80, 0x20, 0xa0, 0xa0, 0x8a, 0x20, 0xa0, 0xa0, 0x8e, 0x20, 0xae, 0xa0,
  0x80, 0x20, 0xff, 0xe0
};

// 'UNO', 15x17px
const unsigned char uno [] PROGMEM = {
  0x38, 0x78, 0xef, 0xce, 0x80, 0x02, 0x80, 0x4a, 0x80, 0x4a, 0xa0, 0x32, 0xa0, 0x02, 0xa0, 0x4a,
  0xa0, 0x6a, 0xa0, 0x5a, 0xa0, 0x4a, 0xa0, 0x02, 0xa0, 0x32, 0xa7, 0x4a, 0xa7, 0x32, 0x80, 0x02,
  0xff, 0xfe
};

// 'LEO', 15x17px
const unsigned char leo [] PROGMEM = {
  0x38, 0x78, 0xef, 0xce, 0x80, 0x02, 0x80, 0x42, 0x80, 0x7a, 0xa0, 0x02, 0xa0, 0x3a, 0xa0, 0x42,
  0xa0, 0x72, 0xa0, 0x42, 0xa0, 0x3a, 0xa0, 0x02, 0xa0, 0x32, 0xa7, 0x4a, 0xa7, 0x32, 0x80, 0x02,
  0xff, 0xfe
};

// 'notready warn', 13x15px with alpha shadow
const unsigned char notready_warn [] PROGMEM = {
  0x00, 0x00, 0x00, 0x00, 0x02, 0x00, 0x05, 0x00, 0x05, 0x00, 0x08, 0x80, 0x0a, 0x80, 0x12, 0x40,
  0x12, 0x40, 0x20, 0x20, 0x22, 0x20, 0x40, 0x10, 0x7f, 0xf0, 0x00, 0x00, 0x00, 0x00
};

const unsigned char notready_warn_shadow [] PROGMEM = {
  0x00, 0x00, 0x02, 0x00, 0x07, 0x00, 0x07, 0x00, 0x0f, 0x80, 0x0f, 0x80, 0x1f, 0xc0, 0x1f, 0xc0,
  0x3f, 0xe0, 0x7f, 0xf0, 0x7f, 0xf0, 0x7f, 0xf0, 0x7f, 0xf0, 0x7f, 0xf0, 0x00, 0x00
};

// 'PC', 31x21px
const unsigned char PC [] PROGMEM = {
  0x00, 0x00, 0x00, 0x00, 0x00, 0x00, 0x7f, 0xfc, 0x00, 0x00, 0x40, 0x04, 0x00, 0x00, 0x40, 0x04,
  0x7f, 0xff, 0xc0, 0x04, 0x40, 0x00, 0x5f, 0xf4, 0x40, 0x00, 0x50, 0x14, 0x40, 0x00, 0x5f, 0xf4,
  0x40, 0x00, 0x40, 0x04, 0x40, 0x00, 0x40, 0x04, 0x40, 0x00, 0x40, 0x04, 0x40, 0x00, 0x40, 0x04,
  0x40, 0x00, 0x40, 0x04, 0x40, 0x00, 0x40, 0x04, 0x40, 0x00, 0x40, 0x04, 0x40, 0x00, 0x40, 0x04,
  0x7f, 0xff, 0xc7, 0xc4, 0x00, 0x20, 0x40, 0x04, 0x01, 0xfc, 0x40, 0x04, 0x00, 0x00, 0x7f, 0xfc,
  0x00, 0x00, 0x00, 0x00
};

const unsigned char PC_shadow [] PROGMEM = {
  0x00, 0x00, 0xff, 0xfe, 0x00, 0x00, 0xff, 0xfe, 0x00, 0x00, 0xff, 0xfe, 0xff, 0xff, 0xff, 0xfe,
  0xff, 0xff, 0xff, 0xfe, 0xff, 0xff, 0xff, 0xfe, 0xff, 0xff, 0xff, 0xfe, 0xff, 0xff, 0xff, 0xfe,
  0xff, 0xff, 0xff, 0xfe, 0xff, 0xff, 0xff, 0xfe, 0xff, 0xff, 0xff, 0xfe, 0xff, 0xff, 0xff, 0xfe,
  0xff, 0xff, 0xff, 0xfe, 0xff, 0xff, 0xff, 0xfe, 0xff, 0xff, 0xff, 0xfe, 0xff, 0xff, 0xff, 0xfe,
  0xff, 0xff, 0xff, 0xfe, 0xff, 0xff, 0xff, 0xfe, 0x03, 0xfe, 0xff, 0xfe, 0x03, 0xfe, 0xff, 0xfe,
  0x00, 0x00, 0xff, 0xfe
};

// 'unresponsive sleep zzz', 11x11px
const unsigned char  zzz [] PROGMEM = {
  0x00, 0x00, 0x01, 0xc0, 0x00, 0x40, 0x00, 0x80, 0x0d, 0x00, 0x05, 0xc0, 0x08, 0x00, 0x6c, 0x00,
  0x20, 0x00, 0x30, 0x00, 0x00, 0x00
};

const unsigned char  zzz_shadow [] PROGMEM = {
  0x03, 0xe0, 0x03, 0xe0, 0x03, 0xe0, 0x1f, 0xe0, 0x1f, 0xe0, 0x1f, 0xe0, 0xff, 0xe0, 0xfe, 0x00,
  0xfe, 0x00, 0x78, 0x00, 0x78, 0x00
};

// 'wait clock', 11x11px
const unsigned char  wait [] PROGMEM = {
  0x00, 0x00, 0x1f, 0x00, 0x20, 0x80, 0x44, 0x40, 0x44, 0x40, 0x46, 0x40, 0x40, 0x40, 0x40, 0x40,
  0x20, 0x80, 0x1f, 0x00, 0x00, 0x00
};
const unsigned char  wait_shadow [] PROGMEM = {
  0x3f, 0x80, 0x7f, 0xc0, 0xff, 0xe0, 0xff, 0xe0, 0xff, 0xe0, 0xff, 0xe0, 0xff, 0xe0, 0xff, 0xe0,
  0xff, 0xe0, 0x7f, 0xc0, 0x3f, 0x80
};

// 'err', 11x11px
const unsigned char  err [] PROGMEM = {
  0x00, 0x00, 0x1f, 0x00, 0x20, 0x80, 0x40, 0x40, 0x40, 0x40, 0x5f, 0x40, 0x40, 0x40, 0x40, 0x40,
  0x20, 0x80, 0x1f, 0x00, 0x00, 0x00
};

const unsigned char  err_shadow [] PROGMEM = {
  0x3f, 0x80, 0x7f, 0xc0, 0xff, 0xe0, 0xff, 0xe0, 0xff, 0xe0, 0xff, 0xe0, 0xff, 0xe0, 0xff, 0xe0,
  0xff, 0xe0, 0x7f, 0xc0, 0x3f, 0x80
};

// 'check', 10x11px
const unsigned char  checkmark [] PROGMEM = {
  0x00, 0x00, 0x00, 0x80, 0x01, 0x80, 0x01, 0x00, 0x03, 0x00, 0x02, 0x00, 0x66, 0x00, 0x34, 0x00,
  0x1c, 0x00, 0x08, 0x00, 0x00, 0x00
};

const unsigned char  checkmark_shadow [] PROGMEM = {
  0x01, 0xc0, 0x03, 0xc0, 0x03, 0xc0, 0x07, 0xc0, 0x07, 0x80, 0xff, 0x80, 0xff, 0x00, 0xff, 0x00,
  0x7e, 0x00, 0x3e, 0x00, 0x1c, 0x00
};

// 'button pushed big', 32x32px
const unsigned char  button_pushed_big [] PROGMEM = {
  0x00, 0x00, 0x00, 0x00, 0x00, 0x00, 0x10, 0x20, 0x00, 0x00, 0x10, 0x20, 0x00, 0x00, 0x10, 0x20,
  0x00, 0x00, 0x10, 0x20, 0x01, 0x00, 0x10, 0x20, 0x01, 0x00, 0x10, 0x20, 0x01, 0x00, 0x10, 0x20,
  0x01, 0x00, 0x20, 0x20, 0x01, 0x00, 0x20, 0x20, 0x01, 0x00, 0x60, 0x60, 0x01, 0x00, 0x60, 0x40,
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  0x04, 0x00, 0x00, 0x20, 0x04, 0x00, 0x00, 0x20, 0x3f, 0xff, 0xff, 0xfc, 0x00, 0x00, 0x00, 0x00
};

const uint8_t __comic15pt7bBitmaps[] PROGMEM = {
  0xDF, 0xFF, 0xFF, 0xFF, 0xFF, 0xFF, 0xFF, 0x01, 0xBE, 0xC6, 0xC7, 0xC7,
  0xC7, 0xC7, 0xC7, 0xC7, 0xC7, 0xC6, 0x00, 0x60, 0x18, 0x00, 0x60, 0x38,
  0x00, 0xE0, 0x38, 0x00, 0xE0, 0x30, 0x00, 0xE0, 0x70, 0x3F, 0xFF, 0xFF,
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  0x3F, 0xD8, 0x3F, 0x00, 0x1C
};

const GFXglyph __comic15pt7bGlyphs[] PROGMEM = {
  {     0,   0,   0,   9,    0,    1 },   // 0x20 ' '
  {     0,   3,  24,   7,    2,  -22 },   // 0x21 '!'
  {     9,   8,   9,  12,    2,  -21 },   // 0x22 '"'
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  {  3242,  15,   8,  17,    1,  -14 }
}; // 0x7E '~'

const GFXfont __comic15pt7b PROGMEM = {
  (uint8_t  *)__comic15pt7bBitmaps,
  (GFXglyph *)__comic15pt7bGlyphs,
  0x20, 0x7E, 40
};

// Approx. 3929 bytes


const uint8_t __comic11pt7bBitmaps[] PROGMEM = {
  0x4D, 0xB6, 0xDB, 0x6D, 0xB6, 0xD0, 0x19, 0x00, 0xC7, 0x3C, 0xF3, 0xCF,
  0x3C, 0xC0, 0x01, 0x83, 0x00, 0xE0, 0xC0, 0x30, 0x30, 0x0C, 0x18, 0x7F,
  0xFF, 0xDF, 0xFF, 0xF0, 0x60, 0xC0, 0x18, 0x30, 0x06, 0x0C, 0x03, 0x03,
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  0xF0, 0x1C
};

const GFXglyph __comic11pt7bGlyphs[] PROGMEM = {
  {     0,   0,   0,   7,    0,    1 },   // 0x20 ' '
  {     0,   3,  19,   5,    1,  -17 },   // 0x21 '!'
  {     8,   6,   7,   9,    1,  -16 },   // 0x22 '"'
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  {  1891,  11,   5,  13,    1,   -9 }
}; // 0x7E '~'

const GFXfont __comic11pt7b PROGMEM = {
  (uint8_t  *)__comic11pt7bBitmaps,
  (GFXglyph *)__comic11pt7bGlyphs,
  0x20, 0x7E, 31
};

// Approx. 2570 bytes

// 70x8px
const unsigned char  edupraha_only [] PROGMEM = {
  0x00, 0x00, 0x00, 0x00, 0x00, 0x00, 0x00, 0x00, 0x00, 0x00, 0x01, 0xd9, 0x26, 0x40, 0x00, 0x33,
  0x12, 0x90, 0x00, 0x01, 0x15, 0x28, 0xa0, 0x64, 0x2a, 0xaa, 0xa8, 0x65, 0x21, 0x95, 0x28, 0xe8,
  0xae, 0x33, 0x3b, 0xb8, 0x56, 0x51, 0x15, 0x28, 0xac, 0xc4, 0x22, 0xaa, 0xa8, 0x64, 0x21, 0xd8,
  0xc6, 0xaa, 0x66, 0x22, 0xaa, 0xa8, 0x40, 0x00, 0x00, 0x00, 0x00, 0x00, 0x00, 0x00, 0x00, 0x00,
  0x00, 0x00, 0x00, 0x00, 0x00, 0x00, 0x00, 0x00
};

// 82x12px
const unsigned char  che [] PROGMEM = {
  0x00, 0x00, 0x00, 0x00, 0x00, 0x00, 0x00, 0x00, 0x00, 0x00, 0x00, 0x1e, 0x20, 0x8f, 0x8e, 0x3e,
  0x7c, 0xf8, 0x70, 0x0f, 0x1f, 0x80, 0x21, 0x20, 0x88, 0x11, 0x08, 0x40, 0x84, 0x88, 0x10, 0x80,
  0x80, 0x40, 0x20, 0x88, 0x10, 0x08, 0x40, 0x84, 0x80, 0x20, 0x01, 0x00, 0x40, 0x20, 0x88, 0x08,
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  0x00, 0x00, 0x00, 0x00
};

// 'msg sent', 29x13px
const unsigned char  msg_sent [] PROGMEM = {
  0x00, 0x00, 0x00, 0x00, 0x01, 0xff, 0xff, 0xf0, 0x1d, 0x80, 0x00, 0x30, 0x01, 0x60, 0x00, 0xd0,
  0x7d, 0x18, 0x03, 0x10, 0x01, 0x06, 0x0c, 0x10, 0xfd, 0x09, 0xb2, 0x10, 0x01, 0x10, 0x41, 0x10,
  0x7d, 0x20, 0x00, 0x90, 0x01, 0x40, 0x00, 0x50, 0x1d, 0x80, 0x00, 0x30, 0x01, 0xff, 0xff, 0xf0,
  0x00, 0x00, 0x00, 0x00
};

const int pcswitchPin = 2;
const int localswitchPin = 3;
const int commsOutPin = 7;
const int commsInPin = 8;
byte pcswitch = 0;
byte commsIn = 0;

int x = 64;
byte y = 16;
int timestamp = 0; //test mode
bool goingright = true;
bool goingup = true;
byte frame = 0;
byte screensaver; // 0 pro amogus, 1 pro čas a 2 pro datum
unsigned long milisAtStart;
int yearAtStart;
byte monthAtStart;
byte dayAtStart;
byte repeats;
bool informedOfVerboseTimeout = false;
byte verboseReportCount = 0;

void setup() {
  Serial.begin(9600);

  pinMode(pcswitchPin, OUTPUT);
  pinMode(localswitchPin, INPUT_PULLUP);
  pinMode(commsOutPin, OUTPUT);
  pinMode(commsInPin, INPUT_PULLUP);

  // SSD1306_SWITCHCAPVCC = generate display voltage from 3.3V internally
  if (!display.begin(SSD1306_SWITCHCAPVCC, SCREEN_ADDRESS)) {
    Serial.println(F("SSD1306 allocation failed"));
    for (;;); // Don't proceed, loop forever
  }

  // Clear the buffer
  display.clearDisplay();
  display.setTextColor(SSD1306_WHITE);

  // Draw a single pixel in white
  // display.drawPixel(10, 10, SSD1306_WHITE);

  // Show the display buffer on the screen. You MUST call display() after
  // drawing commands to make them visible on screen!

  // drawcustombitmap();
  drawSplash();
  display.display();

  Serial.flush();
  delay(500);
  Serial.println(F("Screen module"));
  Serial.flush();

  display.clearDisplay();
  drawPcWaiting();
  display.display();

  delay(2500);
  char rec[32];
  if (Serial.peek() == 'u') {
    Serial.read();

    display.clearDisplay();
    drawPcSuccess();
    display.display();

    switch (Serial.read()) {
      case 'a':
        screensaver = 0;
        // drawCenteredText("screensaver");

        break;
      case 't':
        screensaver = 1;
        // drawCenteredText("time");

        Serial.write("k");
        delay(2000);
        repeats = 0;
        while (Serial.available() > 0) {
          rec[repeats] = Serial.read();
          drawCenteredText(rec, true);
          delay(100);
          repeats++;
        }
        rec[repeats] = '\0';
        Serial.println("final value is " + String(atol(rec)));
        milisAtStart = (atol(rec) * 1000L) - millis();
        break;
      case 'd':
        screensaver = 2;
        // drawCenteredText("date");

        Serial.print('k');
        Serial.flush();
        delay(2000);
        repeats = 0;
        while (Serial.available() > 0) {
          rec[repeats] = Serial.read();
          drawCenteredText(rec, true);
          delay(100);
          repeats++;
        }
        rec[repeats] = '\0';
        Serial.println("final value is " + String(atol(rec)));
        milisAtStart = (atol(rec) * 1000L) - millis();


        Serial.println(F("Clearing Serial buffer..."));
        repeats = 0;
        while (Serial.available() > 0) {
          Serial.read();
          repeats++;
        }
        Serial.println("Cleared " + String(repeats) + " chars");

        delay(1000);
        Serial.print('k');
        Serial.flush();
        delay(1000);

        while (Serial.available() < 1) {
          delay(0);
        }

        char inc[11];
        repeats = 0;
        while (Serial.available() > 0) {
          inc[repeats] = Serial.read();
          draw11pCenteredText(inc, true);
          delay(100);
          repeats++;
        }

        inc[repeats] = '\0';
        String incString = inc;
        Serial.println("Date received as: " + incString);
        yearAtStart = atol(incString.substring(0, 4).c_str());
        monthAtStart = atol(incString.substring(5, 7).c_str());
        dayAtStart = atol(incString.substring(8, 10).c_str());
        Serial.println("Date parsed as: " + String(yearAtStart) + "." + String(monthAtStart) + "." + String(dayAtStart));
    }

    delay(1500);

    display.clearDisplay();
    drawPcSuccess();
    display.display();
  }
  else {
    display.clearDisplay();
    drawPcDisconnected();
    display.display();
    for (byte i = 0; i < 13; i++) {
      display.invertDisplay(i % 2);
      display.display();
      delay(250);
    }
  }

  delay(1000);

  //display.invertDisplay(0);
  //display.display();

  // display.display() is NOT necessary after every single drawing command,
  // unless that's what you want...rather, you can batch up a bunch of
  // drawing operations and then update the screen all at once by calling
  // display.display(). These examples demonstrate both approaches...


  //TODO: drawcustomtext();

  //testdrawbitmap();    // Draw a small bitmap image

  //testdrawchar();      // Draw characters of the default font

  //testdrawstyles();    // Draw 'stylized' characters
  //digitalWrite(pcswitchPin, HIGH);
}

void loop() {

  display.clearDisplay();
  pcswitch = digitalRead(localswitchPin);
  // pcswitch = 0 if pushed, 1 if released

  if (pcswitch == 1) {
    if (frame > 80) frame = frame - 80;

    if (timestamp < 100) {

      display.clearDisplay();
      drawNanoSleep();
      display.display();

      timestamp++;
    }
    else {
      if (screensaver == 1) {
        doClock();
      }
      else if (screensaver == 2) {
        doCalendar();
      }
      else {
        if (x > 117 || x < 1) {
          goingright = !goingright;
        }
        if (y > 21  || y < 1) {
          goingup    = !goingup;
        }

        if (goingright == true) {
          x = x + 1;
        } else {
          x = x - 1;
        }

        if (goingup == true) {
          y = y + 1;
        } else {
          y = y - 1;
        }

        display.clearDisplay();
        display.drawBitmap(x, y, amogus[frame % 6], 10, 10, WHITE);
        frame++;
        display.display();
        delay(30);
      }
    }



  } else {
    Serial.println(F("pushed"));

    digitalWrite(pcswitchPin, HIGH);
    pcswitch = digitalRead(localswitchPin);
    while (pcswitch == 0) {
      display.clearDisplay();
      drawButtonPushedBig();
      display.display();
      delay(50);
      pcswitch = digitalRead(localswitchPin);
    }
    digitalWrite(pcswitchPin, LOW);
    commsIn = digitalRead(commsInPin);
    Serial.print("commsIn: ");
    Serial.println(commsIn);
    if (commsIn == 1) {
      Serial.println("audio module not ready yet");
      // Not ready to play sound, show error message and continue
      frame = 0;
      while (frame < 7) {
        display.clearDisplay();
        drawNotReady(frame % 2);
        // display.drawBitmap(0, 0, notready[frame % 2], 128, 32, WHITE);
        display.display();
        delay(500);
        frame++;
      }
      frame = 0;
    } else {
      frame = 89;
      display.clearDisplay();
      drawContactingNano();
      display.display();
      digitalWrite(commsOutPin, HIGH);
      while (commsIn == 0) {
        if (frame % 89 == 0) {
          display.clearDisplay();
          drawContactingNano();
          display.display();
        } if (frame == 255) {
          Serial.print("request timed out");
          frame = 0;
          while (frame < 7) {
            display.clearDisplay();
            drawTimedOut(frame % 2);
            // display.drawBitmap(0, 0, notready[frame % 2], 128, 32, WHITE);
            display.display();
            delay(500);
            frame++;
          }
          return;
        }
        display.drawPixel((frame % 89) + 18, 13, BLACK);
        display.drawPixel((frame % 89) + 19, 13, WHITE);
        display.drawPixel((frame % 89) + 20, 13, WHITE);
        display.drawPixel((frame % 89) + 21, 13, WHITE);

        display.drawBitmap(59, 7, wait_shadow, 11, 11, BLACK);
        display.drawBitmap(59, 7, wait, 11, 11, WHITE);

        display.display();

        frame++;
        commsIn = digitalRead(commsInPin);
      }
      // connection established, playing sound...
      digitalWrite(commsOutPin, LOW);
    }
    delay(250);
    timestamp = 0;
  }

}

void drawSplash() {
  display.clearDisplay();
  display.drawBitmap(8, 0, big_chester, 33, 32, WHITE);
  display.drawBitmap(41, 11, che, 82, 13, WHITE);
  display.display();
  delay(750);

  for (int i = 0; i < 7; i++) {

    display.clearDisplay();
    display.drawBitmap(8, 0, big_chester, 33, 32, WHITE);
    display.drawBitmap(48, 15 + i, edupraha_only, 70, 8, WHITE);
    display.fillRect(41, 11 - i, 82, 14, BLACK);
    display.drawBitmap(41, 11 - i, che, 82, 13, WHITE);
    display.display();
    delay(100);
  }

  delay(1000);
}

void doClock() {
  long rnMilis = milisAtStart + millis();
  long rnSecs = rnMilis / 1000;
  long rnMins = rnSecs / 60;
  long rnHours = rnMins / 60;

  rnMilis = rnMilis % 1000;
  rnSecs = rnSecs % 60;
  rnMins = rnMins % 60;
  rnHours = rnHours % 24;

  drawCenteredText(noToDD(rnHours) + ":" + noToDD(rnMins) + ":" + noToDD(rnSecs));
}

void doCalendar() {
  {
    long rnMilis = milisAtStart + millis();
    long rnSecs = rnMilis / 1000;
    long rnMins = rnSecs / 60;
    long rnHours = rnMins / 60;

    byte rnDays = dayAtStart + rnHours / 24;
    byte rnMonth = monthAtStart;
    int rnYear = yearAtStart;


    // Arduino nedokáže udržet přesnej čas o moc dýl než 50 dní, takže
    // se nemůže stát, že by tenhle forloop nestačil. I tak jsem pro
    // jistotu použil 3x loop, aby nebyla ani majinkatá šance.
    for (int i = 0; i < 3; i++) {
      if (rnDays > 28) {
        switch (rnMonth) {
          case 1:
          case 3:
          case 5:
          case 7:
          case 8:
          case 10:
            if (rnDays > 31) {
              rnDays = rnDays - 31;
              rnMonth++;
            }
            break;
          case 4:
          case 6:
          case 9:
          case 11:
            if (rnDays > 30) {
              rnDays = rnDays - 30;
              rnMonth++;
            }
            break;
          case 2:
            if (rnDays > 28) {
              rnDays = rnDays - 28;
              rnMonth++;
            }
            break;
          case 12:
            if (rnDays > 31) {
              rnDays = rnDays - 31;
              rnMonth = 1;
              rnYear++;
            }
            break;
        }
      }
    }

    rnMilis = rnMilis % 1000;
    rnSecs = rnSecs % 60;
    rnMins = rnMins % 60;
    rnHours = rnHours % 24;

    draw11pCenteredText(noToDD(rnDays) + "." + noToDD(rnMonth) + "." + rnYear);
  }
}

String noToDD(long i) { // Double Digits
  if (i < 10)
    return "0" + String(i);
  else
    return String(i);
}

String noToTD(long i) { // Triple Digits
  if (i < 10)
    return "00" + String(i);
  else if (i < 100)
    return "0" + String(i);
  else
    return String(i);
}

void drawCenteredText(String str, bool forcePrintVerbose) {
  unsigned int width;
  unsigned int height;
  int curX;
  int curY;

  display.clearDisplay();
  display.setTextColor(SSD1306_WHITE);
  display.setFont(&__comic15pt7b);
  display.setTextSize(1);
  display.getTextBounds(str, 0, 0, &curX, &curY, &width, &height);  // na pozicích curX a curY to vrací souřadnice spodního levýho rohu, což nepotřebuju, ale ty pozice musej bejt vyplněný, tak používám něco, co pak hned přepíšu

  curX = 63 - (width / 2);
  curY = 15 + (height / 2) ;

  if (verboseReportCount % 250 == 0 || forcePrintVerbose)
    Serial.println(str);
  // Serial.println(str + ", " + String(width) + ", " + String(height) + ", " + String(curX) + ", " + String(curY));

  verboseReportCount++;

  if (verboseReportCount > 250) {
    verboseReportCount = verboseReportCount - 250;
  }

  display.setCursor(curX, curY);
  display.println(str);
  display.display();

  display.setFont();
}

void drawCenteredText(String str) {
  drawCenteredText(str, false);
}



void draw11pCenteredText(String str, bool forcePrintVerbose) {
  unsigned int width;
  unsigned int height;
  int curX;
  int curY;

  display.clearDisplay();
  display.setTextColor(SSD1306_WHITE);
  display.setFont(&__comic11pt7b);
  display.getTextBounds(str, 0, 0, &curX, &curY, &width, &height);  // na pozicích curX a curY to vrací souřadnice spodního levýho rohu, což nepotřebuju, ale ty pozice musej bejt vyplněný, tak používám něco, co pak hned přepíšu

  curX = 63 - (width / 2) ;
  curY = 15 + (height / 2)  ;

  if (verboseReportCount % 250 == 0 || forcePrintVerbose)
    Serial.println(str);
  // Serial.println(str + ", " + String(width) + ", " + String(height) + ", " + String(curX) + ", " + String(curY));

  verboseReportCount++;

  if (verboseReportCount > 250) {
    verboseReportCount = verboseReportCount - 250;
  }

  display.setCursor(curX, curY);
  display.println(str);
  display.display();

  display.setFont();
}

void draw11pCenteredText(String str) {
  draw11pCenteredText(str, false);
}


void drawlogoincorner(void) {
  display.drawBitmap(8, 0, big_chester, 33, 32, WHITE);
}

void testdrawchar(void) {
  display.clearDisplay();

  display.setTextSize(1);      // Normal 1:1 pixel scale
  display.setTextColor(SSD1306_WHITE); // Draw white text
  display.setCursor(0, 0);     // Start at top-left corner
  display.cp437(true);         // Use full 256 char 'Code Page 437' font

  // Not all the characters will fit on the display. This is normal.
  // Library will draw what it can and the rest will be clipped.
  for (int16_t i = 0; i < 256; i++) {
    if (i == '\n') display.write(' ');
    else          display.write(i);
  }

  display.display();
  delay(2000);
}

void drawNanoAndNano() {
  display.drawBitmap(7, 4, nano, 11, 18, WHITE);
  display.drawBitmap(110, 4, nano, 11, 18, WHITE);
}

void drawContactingNano() {
  drawNanoAndNano();
  display.setTextSize(1);
  display.setCursor(28, 24);
  display.println(F("contacting nano"));
  display.drawPixel(118, 30, WHITE);
  display.drawPixel(120, 30, WHITE);
  display.drawPixel(122, 30, WHITE);

  display.drawBitmap(59, 7, wait_shadow, 11, 11, BLACK);
  display.drawBitmap(59, 7, wait, 11, 11, WHITE);
}

void drawNotReady(bool frame) {
  drawNanoAndNano();
  if (frame) {
    display.drawBitmap(109, 5, notready_warn_shadow, 13, 15, BLACK);
    display.drawBitmap(109, 5, notready_warn, 13, 15, WHITE);
  }

  display.setFont();
  display.setTextColor(WHITE);
  display.setTextSize(1);
  display.setCursor(24, 24);
  display.println("not ready to play");
}

void drawTimedOut(bool frame) {
  drawNanoAndNano();
  display.drawBitmap(46, 7, msg_sent, 29, 13, WHITE);

  if (frame) {
    display.drawBitmap(57, 4, notready_warn_shadow, 13, 15, BLACK);
    display.drawBitmap(57, 4, notready_warn, 13, 15, WHITE);
  }

  display.setFont();
  display.setTextColor(WHITE);
  display.setTextSize(1);
  display.setCursor(69, 24);
  display.println("timed out");
}

void drawPcDisconnected() {
  drawPc(false);
  display.drawBitmap(99, 14, err_shadow, 11, 11, BLACK);
  display.drawBitmap(99, 14, err, 11, 11, WHITE);

  display.setFont();
  display.setTextColor(WHITE);
  display.setCursor(0, 4);
  display.println(" Not connected\n to script or\n sctipt failed");
}

void drawPcWaiting() {
  drawPc(true);
  display.drawBitmap(54, 13, wait_shadow, 11, 11, BLACK);
  display.drawBitmap(54, 13, wait, 11, 11, WHITE);
}

void drawPc(bool center) {
  if (center) {
    display.drawBitmap(49, 8, PC_shadow, 31, 21, BLACK);
    display.drawBitmap(49, 8, PC, 31, 21, WHITE);

  } else {
    display.drawBitmap(94, 9, PC_shadow, 31, 21, BLACK);
    display.drawBitmap(94, 9, PC, 31, 21, WHITE);
  }
}

void drawNanoSleep() {
  display.drawBitmap(59, 11, nano, 11, 18, WHITE);
  display.drawBitmap(69, 4, zzz_shadow, 11, 11, BLACK);
  display.drawBitmap(69, 4, zzz, 11, 11, WHITE);
}

void drawPcSuccess() {
  drawPc(true);
  display.drawBitmap(55, 13, checkmark_shadow, 10, 11, BLACK);
  display.drawBitmap(55, 13, checkmark, 10, 11, WHITE);
}

void drawButtonPushedBig() {
  display.drawBitmap(47, 0, button_pushed_big, 32, 32, WHITE);
}

void testdrawstyles(void) {
  display.clearDisplay();

  display.setTextSize(1);             // Normal 1:1 pixel scale
  display.setTextColor(SSD1306_WHITE);        // Draw white text
  display.setCursor(0, 0);            // Start at top-left corner
  display.println(F("Hello, world!"));

  display.setTextColor(SSD1306_BLACK, SSD1306_WHITE); // Draw 'inverse' text
  display.println(3.141592);

  display.setTextSize(2);             // Draw 2X-scale text
  display.setTextColor(SSD1306_WHITE);
  display.print(F("0x")); display.println(0xDEADBEEF, HEX);

  display.display();
  delay(2000);
}

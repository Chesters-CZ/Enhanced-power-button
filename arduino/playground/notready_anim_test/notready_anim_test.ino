
#include <Wire.h>
#include <Adafruit_GFX.h>
#include <Adafruit_SSD1306.h>


#define SCREEN_WIDTH 128 // OLED display width, in pixels
#define SCREEN_HEIGHT 32 // OLED display height, in pixels

#define OLED_RESET     -1 // Reset pin # (or -1 if sharing Arduino reset pin)
#define SCREEN_ADDRESS 0x3C ///< See datasheet for Address; 0x3D for 128x64, 0x3C for 128x32

#define SERIAL_BUFFER_SIZE 16

Adafruit_SSD1306 display(SCREEN_WIDTH, SCREEN_HEIGHT, &Wire, OLED_RESET);

const unsigned char nano [] PROGMEM = {
  // 'NANO, 11x18px
  0x1f, 0x00, 0xf1, 0xe0, 0x8e, 0x20, 0xa0, 0xa0, 0x80, 0x20, 0xa0, 0xa0, 0x80, 0x20, 0xa0, 0xa0,
  0x80, 0x20, 0xa0, 0xa0, 0x80, 0x20, 0xa0, 0xa0, 0x8a, 0x20, 0xa0, 0xa0, 0x8e, 0x20, 0xae, 0xa0,
  0x80, 0x20, 0xff, 0xe0
};

const unsigned char uno [] PROGMEM = {
  // 'UNO, 15x17px
  0x38, 0x78, 0xef, 0xce, 0x80, 0x02, 0xa0, 0x0a, 0xa0, 0x0a, 0xaa, 0xaa, 0xa0, 0x0a, 0xa0, 0x0a,
  0xa0, 0x0a, 0xa0, 0x0a, 0xa0, 0x0a, 0xa0, 0x0a, 0xa0, 0x0a, 0xa3, 0x8a, 0xa3, 0x8a, 0x80, 0x02,
  0xff, 0xfe
};

// 'notready warn', 13x15px
const unsigned char notready_warn [] PROGMEM = {
  0x00, 0x00, 0x00, 0x00, 0x02, 0x00, 0x05, 0x00, 0x05, 0x00, 0x08, 0x80, 0x0a, 0x80, 0x12, 0x40,
  0x12, 0x40, 0x20, 0x20, 0x22, 0x20, 0x40, 0x10, 0x7f, 0xf0, 0x00, 0x00, 0x00, 0x00
};

const unsigned char notready_warn_shadow [] PROGMEM = {
  0x00, 0x00, 0x02, 0x00, 0x07, 0x00, 0x07, 0x00, 0x0f, 0x80, 0x0f, 0x80, 0x1f, 0xc0, 0x1f, 0xc0,
  0x3f, 0xe0, 0x7f, 0xf0, 0x7f, 0xf0, 0x7f, 0xf0, 0x7f, 0xf0, 0x7f, 0xf0, 0x00, 0x00
};


byte frame = 0;


void setup() {
  if (!display.begin(SSD1306_SWITCHCAPVCC, SCREEN_ADDRESS)) {
    Serial.println(F("SSD1306 allocation failed"));
    for (;;); // Don't proceed, loop forever
  }
}

void loop() {
  drawNotReady(frame % 2);
  display.display();
  frame++;
  delay(500);
}

void drawNanoAndNano() {
  display.clearDisplay();
  display.drawBitmap(7, 4, nano, 11, 18, WHITE);
  display.drawBitmap(110, 4, nano, 11, 18, WHITE);
  display.setTextSize(1);
  display.setCursor(18, 24);
  display.println(F("contacting nano"));
  display.drawPixel(108, 30, WHITE);
  display.drawPixel(110, 30, WHITE);
  display.drawPixel(112, 30, WHITE);
}

void drawNotReady(bool frame) {
  drawNanoAndNano();
  if (frame) {
    display.drawBitmap(109, 5, notready_warn_shadow, 13, 15, BLACK);
    display.drawBitmap(109, 5, notready_warn, 13, 15, WHITE);
  }
}

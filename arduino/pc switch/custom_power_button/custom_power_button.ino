/**************************************************************************
  This is an example for our Monochrome OLEDs based on SSD1306 drivers

  Pick one up today in the adafruit shop!
  ------> http://www.adafruit.com/category/63_98

  This example is for a 128x32 pixel display using I2C to communicate
  3 pins are required to interface (two I2C and one reset).

  Adafruit invests time and resources providing this ;open
  source code, please support Adafruit and open-source
  hardware by purchasing products from Adafruit!

  Written by Limor Fried/Ladyada for Adafruit Industries,
  with contributions from the open source community.
  BSD license, check license.txt for more information
  All text above, and the splash screen below must be
  included in any redistribution.
 **************************************************************************/

#include <Wire.h>
#include <Adafruit_GFX.h>
#include <Adafruit_SSD1306.h>

#define SCREEN_WIDTH 128 // OLED display width, in pixels
#define SCREEN_HEIGHT 32 // OLED display height, in pixels

// Declaration for an SSD1306 display connected to I2C (SDA, SCL pins)
// The pins for I2C are defined by the Wire-library.
// On an arduino UNO:       A4(SDA), A5(SCL)
// On an arduino MEGA 2560: 20(SDA), 21(SCL)
// On an arduino LEONARDO:   2(SDA),  3(SCL), ...
#define OLED_RESET     -1 // Reset pin # (or -1 if sharing Arduino reset pin)
#define SCREEN_ADDRESS 0x3C ///< See datasheet for Address; 0x3D for 128x64, 0x3C for 128x32
Adafruit_SSD1306 display(SCREEN_WIDTH, SCREEN_HEIGHT, &Wire, OLED_RESET);

// #define NUMFLAKES     10 // Number of snowflakes in the animation example

#define LOGO_HEIGHT   16
#define LOGO_WIDTH    16

#define SERIAL_BUFFER_SIZE 16

static const unsigned char PROGMEM logo_bmp[] =
{ 0b00000000, 0b11000000,
  0b00000001, 0b11000000,
  0b00000001, 0b11000000,
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  0b00000000, 0b00110000
};

// chester logo bez edupraha, 128x32px
static const unsigned char myBitmaplogo [] PROGMEM = {
  0x00, 0x00, 0x00, 0x00, 0x00, 0x00, 0x00, 0x00, 0x00, 0x00, 0x00, 0x00, 0x00, 0x00, 0x00, 0x00,
  0x00, 0x00, 0x00, 0x00, 0x00, 0x00, 0x00, 0x00, 0x00, 0x00, 0x00, 0x00, 0x00, 0x00, 0x00, 0x00,
  0x00, 0x01, 0xe0, 0x07, 0x80, 0x00, 0x00, 0x00, 0x00, 0x00, 0x00, 0x00, 0x00, 0x00, 0x00, 0x00,
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  0x00, 0x00, 0x00, 0x00, 0x00, 0x00, 0x00, 0x00, 0x00, 0x00, 0x00, 0x00, 0x00, 0x00, 0x00, 0x00
};

// 'god dammit kris', 128x32px
const unsigned char god_dammit_kris [] PROGMEM = {
  0xff, 0xff, 0xff, 0xff, 0xff, 0xff, 0xff, 0xff, 0xff, 0xff, 0xff, 0xf8, 0x03, 0xff, 0xff, 0xff,
  0xff, 0xff, 0xff, 0xff, 0xff, 0xff, 0xff, 0xff, 0xff, 0xff, 0xff, 0xc7, 0xfb, 0xfe, 0x07, 0xff,
  0xff, 0xff, 0xff, 0xff, 0xff, 0xff, 0xff, 0xff, 0xff, 0xff, 0xfe, 0x3f, 0xf7, 0xf9, 0xf9, 0xff,
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  0xff, 0xff, 0xff, 0xff, 0xff, 0xff, 0xff, 0xff, 0xff, 0xe3, 0xff, 0xe0, 0x7f, 0xf8, 0x00, 0xff
};

const unsigned char god_dammit_kris_inverted [] PROGMEM = {
  0x00, 0x00, 0x00, 0x00, 0x00, 0x00, 0x00, 0x00, 0x00, 0x00, 0x00, 0x07, 0xfc, 0x00, 0x00, 0x00,
  0x00, 0x00, 0x00, 0x00, 0x00, 0x00, 0x00, 0x00, 0x00, 0x00, 0x00, 0x38, 0x04, 0x01, 0xf8, 0x00,
  0x00, 0x00, 0x00, 0x00, 0x00, 0x00, 0x00, 0x00, 0x00, 0x00, 0x01, 0xc0, 0x08, 0x06, 0x06, 0x00,
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  0x00, 0x00, 0x00, 0x00, 0x00, 0x00, 0x00, 0x00, 0x00, 0x1c, 0x00, 0x1f, 0x80, 0x07, 0xff, 0x00
};

static const unsigned char big_chester [] PROGMEM = {
  0x00, 0x00, 0x00, 0x00, 0x00, 0x00, 0x00, 0x00, 0x00, 0x00, 0x01, 0xe0, 0x07, 0x80, 0x00, 0x02,
  0x1f, 0xf8, 0x40, 0x00, 0x02, 0xd0, 0x0b, 0x40, 0x00, 0x02, 0xd0, 0x0b, 0x40, 0x00, 0x02, 0x10,
  0x08, 0x60, 0x00, 0x05, 0xe0, 0x07, 0x98, 0x00, 0x08, 0x00, 0x00, 0x04, 0x00, 0x10, 0x00, 0x00,
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  0x00, 0x18, 0x00, 0x3e, 0x40, 0x00, 0x00, 0x00, 0x01, 0x80, 0x00, 0x00, 0x00, 0x00, 0x00, 0x00
};

const unsigned char amogus [][20] PROGMEM = {
  {
    0x00, 0x00, 0x7e, 0x00, 0x91, 0x00, 0xa1, 0x00, 0x40, 0x80, 0x40, 0x80, 0x26, 0x80, 0x19, 0x00,
    0x10, 0x00, 0x00, 0x00
  },
  {
    0x07, 0x00, 0x78, 0x80, 0xa0, 0x40, 0xc0, 0x40, 0x40, 0x40, 0x20, 0x40, 0x22, 0x80, 0x15, 0x00,
    0x18, 0x00, 0x00, 0x00
  },
  {
    0x00, 0x00, 0x7e, 0x00, 0x89, 0x80, 0x90, 0x40, 0xe0, 0x40, 0x20, 0x40, 0x20, 0x80, 0x17, 0x00,
    0x18, 0x00, 0x00, 0x00
  },
  {
    0x00, 0x00, 0x38, 0x00, 0x47, 0x00, 0x48, 0x80, 0x50, 0x40, 0x20, 0x40, 0x20, 0x40, 0x20, 0x80,
    0x1f, 0x00, 0x00, 0x00
  },
  {
    0x00, 0x00, 0x3c, 0x00, 0x47, 0x00, 0xbc, 0x80, 0x40, 0x40, 0x40, 0x80, 0x40, 0x80, 0x67, 0x00,
    0x18, 0x00, 0x00, 0x00
  },
  {
    0x00, 0x00, 0x3e, 0x00, 0xe1, 0x00, 0xc0, 0x80, 0x40, 0x80, 0x40, 0x80, 0x22, 0x80, 0x25, 0x00,
    0x18, 0x00, 0x00, 0x00
  }
};

const unsigned char amogus_big [][128] PROGMEM = {
  {
    0x00, 0x00, 0x00, 0x00, 0x00, 0x00, 0x00, 0x00, 0x00, 0x1f, 0xe0, 0x00, 0x03, 0xe0, 0x18, 0x00,
    0x0c, 0x80, 0x06, 0x00, 0x11, 0x00, 0x01, 0x00, 0x22, 0x00, 0x00, 0x80, 0x24, 0x00, 0x00, 0x80,
    0x44, 0x00, 0x00, 0x40, 0x44, 0x00, 0x00, 0x20, 0x7c, 0x00, 0x00, 0x20, 0x8c, 0x00, 0x00, 0x20,
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    0x00, 0x00, 0x00, 0x00, 0x00, 0x00, 0x00, 0x00, 0x00, 0x00, 0x00, 0x00, 0x00, 0x00, 0x00, 0x00
  },
  {
    0x00, 0x00, 0x00, 0x00, 0x00, 0x00, 0x7f, 0x00, 0x00, 0x01, 0x80, 0xe0, 0x01, 0xfe, 0x00, 0x10,
    0x0e, 0x08, 0x00, 0x08, 0x12, 0x10, 0x00, 0x04, 0x22, 0x20, 0x00, 0x02, 0x41, 0xc0, 0x00, 0x01,
    0x40, 0x00, 0x00, 0x01, 0x40, 0x00, 0x00, 0x01, 0x70, 0x00, 0x00, 0x01, 0x88, 0x00, 0x00, 0x01,
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    0x00, 0x00, 0x00, 0x00, 0x00, 0x00, 0x00, 0x00, 0x00, 0x00, 0x00, 0x00, 0x00, 0x00, 0x00, 0x00
  },
  {
    0x00, 0x00, 0x00, 0x00, 0x00, 0x00, 0x00, 0x00, 0x00, 0x00, 0x00, 0x00, 0x00, 0x00, 0x00, 0x00,
    0x07, 0xff, 0xfe, 0x00, 0x18, 0x80, 0x41, 0xc0, 0x21, 0x00, 0x80, 0x30, 0x21, 0x03, 0x00, 0x08,
    0x40, 0x84, 0x00, 0x06, 0x40, 0x78, 0x00, 0x02, 0x70, 0x00, 0x00, 0x01, 0x88, 0x00, 0x00, 0x01,
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    0x00, 0x00, 0x00, 0x00, 0x00, 0x00, 0x00, 0x00, 0x00, 0x00, 0x00, 0x00, 0x00, 0x00, 0x00, 0x00
  },
  {
    0x00, 0x00, 0x00, 0x00, 0x00, 0x00, 0x00, 0x00, 0x00, 0x00, 0x00, 0x00, 0x00, 0x00, 0x00, 0x00,
    0x00, 0x60, 0x00, 0x00, 0x03, 0x9e, 0x00, 0x00, 0x0c, 0x61, 0xf8, 0x00, 0x10, 0x80, 0x27, 0x00,
    0x10, 0x80, 0x10, 0x80, 0x20, 0x80, 0x60, 0x60, 0x20, 0x41, 0x80, 0x10, 0x38, 0x26, 0x00, 0x08,
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    0x00, 0x3f, 0xf0, 0x00, 0x00, 0x00, 0x00, 0x00, 0x00, 0x00, 0x00, 0x00, 0x00, 0x00, 0x00, 0x00
  },
  {
    0x00, 0x00, 0x00, 0x00, 0x00, 0x00, 0x00, 0x00, 0x00, 0x00, 0x00, 0x00, 0x00, 0xc0, 0x00, 0x00,
    0x07, 0x39, 0xc0, 0x00, 0x08, 0x1f, 0x3c, 0x00, 0x10, 0x60, 0x83, 0x00, 0x20, 0x80, 0x40, 0xc0,
    0x20, 0x80, 0x20, 0x20, 0x30, 0x80, 0x40, 0x10, 0x48, 0x41, 0x80, 0x08, 0x51, 0x46, 0x00, 0x08,
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    0x00, 0x00, 0x00, 0x00, 0x00, 0x00, 0x00, 0x00, 0x00, 0x00, 0x00, 0x00, 0x00, 0x00, 0x00, 0x00
  },
  {
    0x00, 0x00, 0x00, 0x00, 0x00, 0x00, 0x00, 0x00, 0x00, 0x00, 0x00, 0x00, 0x00, 0xc0, 0x00, 0x00,
    0x07, 0x3f, 0xfc, 0x00, 0x08, 0x20, 0x03, 0x00, 0x11, 0xc0, 0x00, 0x80, 0x21, 0x00, 0x00, 0x40,
    0x42, 0x00, 0x00, 0x40, 0x64, 0x00, 0x00, 0x20, 0x94, 0x00, 0x00, 0x20, 0xe8, 0x00, 0x00, 0x10,
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    0x00, 0x00, 0x00, 0x00, 0x00, 0x00, 0x00, 0x00, 0x00, 0x00, 0x00, 0x00, 0x00, 0x00, 0x00, 0x00
  }
};

const unsigned char nano [] PROGMEM = {
  // 'NANO, 11x18px
  0x1f, 0x00, 0xf1, 0xe0, 0x8e, 0x20, 0xa0, 0xa0, 0x80, 0x20, 0xa0, 0xa0, 0x80, 0x20, 0xa0, 0xa0,
  0x80, 0x20, 0xa0, 0xa0, 0x80, 0x20, 0xa0, 0xa0, 0x8a, 0x20, 0xa0, 0xa0, 0x8e, 0x20, 0xae, 0xa0,
  0x80, 0x20, 0xff, 0xe0
};

const unsigned char uno [] PROGMEM = {
  // 'UNO, 15x17px
  0x38, 0x78, 0xef, 0xce, 0x80, 0x02, 0xa0, 0x0a, 0xa0, 0x0a, 0xaa, 0xaa, 0xa0, 0x0a, 0xa0, 0x0a,
  0xa0, 0x0a, 0xa0, 0x0a, 0xa0, 0x0a, 0xa0, 0x0a, 0xa0, 0x0a, 0xa3, 0x8a, 0xa3, 0x8a, 0x80, 0x02,
  0xff, 0xfe
};


const unsigned char notready [][512] PROGMEM = {
  {
    0x00, 0x00, 0x00, 0x00, 0x00, 0x00, 0x00, 0x00, 0x00, 0x00, 0x00, 0x00, 0x00, 0x00, 0x00, 0x00,
    0x00, 0x00, 0x00, 0x00, 0x00, 0x00, 0x00, 0x00, 0x00, 0x00, 0x00, 0x00, 0x00, 0x00, 0x00, 0x00,
    0x00, 0x00, 0x00, 0x00, 0x00, 0x00, 0x00, 0x00, 0x00, 0x00, 0x00, 0x00, 0x00, 0x00, 0x00, 0x00,
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    0x00, 0x00, 0x00, 0x00, 0x00, 0x00, 0x00, 0x00, 0x00, 0x00, 0x00, 0x00, 0x00, 0x00, 0x00, 0x00
  }, {
    // 'frame_1_delay-0', 128x32px
    0x00, 0x00, 0x00, 0x00, 0x00, 0x00, 0x00, 0x00, 0x00, 0x00, 0x00, 0x00, 0x00, 0x00, 0x00, 0x00,
    0x00, 0x00, 0x00, 0x00, 0x00, 0x00, 0x00, 0x00, 0x00, 0x00, 0x00, 0x00, 0x00, 0x00, 0x00, 0x00,
    0x00, 0x00, 0x00, 0x00, 0x00, 0x00, 0x00, 0x00, 0x00, 0x00, 0x00, 0x00, 0x00, 0x00, 0x00, 0x00,
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    0x00, 0x00, 0x00, 0x00, 0x00, 0x00, 0x00, 0x00, 0x00, 0x00, 0x00, 0x00, 0x00, 0x00, 0x00, 0x00
  }
};


const uint8_t __comic15pt7bBitmaps[] PROGMEM = {
  0xDF, 0xFF, 0xFF, 0xFF, 0xFF, 0xFF, 0xFF, 0x01, 0xBE, 0xC6, 0xC7, 0xC7,
  0xC7, 0xC7, 0xC7, 0xC7, 0xC7, 0xC6, 0x00, 0x60, 0x18, 0x00, 0x60, 0x38,
  0x00, 0xE0, 0x38, 0x00, 0xE0, 0x30, 0x00, 0xE0, 0x70, 0x3F, 0xFF, 0xFF,
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  0x3F, 0xD8, 0x3F, 0x00, 0x1C
};

const GFXglyph __comic15pt7bGlyphs[] PROGMEM = {
  {     0,   0,   0,   9,    0,    1 },   // 0x20 ' '
  {     0,   3,  24,   7,    2,  -22 },   // 0x21 '!'
  {     9,   8,   9,  12,    2,  -21 },   // 0x22 '"'
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  {  3242,  15,   8,  17,    1,  -14 }
}; // 0x7E '~'

const GFXfont __comic15pt7b PROGMEM = {
  (uint8_t  *)__comic15pt7bBitmaps,
  (GFXglyph *)__comic15pt7bGlyphs,
  0x20, 0x7E, 40
};

// Approx. 3929 bytes


const uint8_t __comic11pt7bBitmaps[] PROGMEM = {
  0x4D, 0xB6, 0xDB, 0x6D, 0xB6, 0xD0, 0x19, 0x00, 0xC7, 0x3C, 0xF3, 0xCF,
  0x3C, 0xC0, 0x01, 0x83, 0x00, 0xE0, 0xC0, 0x30, 0x30, 0x0C, 0x18, 0x7F,
  0xFF, 0xDF, 0xFF, 0xF0, 0x60, 0xC0, 0x18, 0x30, 0x06, 0x0C, 0x03, 0x03,
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  0xF0, 0x1C };

const GFXglyph __comic11pt7bGlyphs[] PROGMEM = {
  {     0,   0,   0,   7,    0,    1 },   // 0x20 ' '
  {     0,   3,  19,   5,    1,  -17 },   // 0x21 '!'
  {     8,   6,   7,   9,    1,  -16 },   // 0x22 '"'
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  {  1891,  11,   5,  13,    1,   -9 } }; // 0x7E '~'

const GFXfont __comic11pt7b PROGMEM = {
  (uint8_t  *)__comic11pt7bBitmaps,
  (GFXglyph *)__comic11pt7bGlyphs,
  0x20, 0x7E, 31 };

// Approx. 2570 bytes

const uint8_t __comic9pt7bBitmaps[] PROGMEM = {
  0xFF, 0xFF, 0xFF, 0x3C, 0xCE, 0xF7, 0xBD, 0xEC, 0x02, 0x08, 0x0C, 0x30,
  0x18, 0x63, 0xFF, 0xF7, 0xFF, 0xE1, 0x86, 0x02, 0x08, 0x0C, 0x30, 0xFF,
  0xFD, 0xFF, 0xF8, 0x41, 0x01, 0x86, 0x03, 0x0C, 0x04, 0x18, 0x00, 0x0C,
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  0x8C, 0xF3, 0x80, 0x30, 0x3C, 0x73, 0x79, 0xF8, 0x70 };

const GFXglyph __comic9pt7bGlyphs[] PROGMEM = {
  {     0,   0,   0,   5,    0,    1 },   // 0x20 ' '
  {     0,   2,  15,   4,    1,  -13 },   // 0x21 '!'
  {     4,   5,   6,   8,    1,  -13 },   // 0x22 '"'
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  {  1275,   9,   5,  11,    1,   -8 } }; // 0x7E '~'

const GFXfont __comic9pt7b PROGMEM = {
  (uint8_t  *)__comic9pt7bBitmaps,
  (GFXglyph *)__comic9pt7bGlyphs,
  0x20, 0x7E, 25 };

// Approx. 1953 bytes


// 70x8px
const unsigned char  edupraha_only [] PROGMEM = {
  0x00, 0x00, 0x00, 0x00, 0x00, 0x00, 0x00, 0x00, 0x00, 0x00, 0x01, 0xd9, 0x26, 0x40, 0x00, 0x33,
  0x12, 0x90, 0x00, 0x01, 0x15, 0x28, 0xa0, 0x64, 0x2a, 0xaa, 0xa8, 0x65, 0x21, 0x95, 0x28, 0xe8,
  0xae, 0x33, 0x3b, 0xb8, 0x56, 0x51, 0x15, 0x28, 0xac, 0xc4, 0x22, 0xaa, 0xa8, 0x64, 0x21, 0xd8,
  0xc6, 0xaa, 0x66, 0x22, 0xaa, 0xa8, 0x40, 0x00, 0x00, 0x00, 0x00, 0x00, 0x00, 0x00, 0x00, 0x00,
  0x00, 0x00, 0x00, 0x00, 0x00, 0x00, 0x00, 0x00
};

// 82x12px
const unsigned char  che [] PROGMEM = {
  0x00, 0x00, 0x00, 0x00, 0x00, 0x00, 0x00, 0x00, 0x00, 0x00, 0x00, 0x1e, 0x20, 0x8f, 0x8e, 0x3e,
  0x7c, 0xf8, 0x70, 0x0f, 0x1f, 0x80, 0x21, 0x20, 0x88, 0x11, 0x08, 0x40, 0x84, 0x88, 0x10, 0x80,
  0x80, 0x40, 0x20, 0x88, 0x10, 0x08, 0x40, 0x84, 0x80, 0x20, 0x01, 0x00, 0x40, 0x20, 0x88, 0x08,
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  0x00, 0x00, 0x00, 0x00
};

const int pcswitchPin = 2;
const int localswitchPin = 3;
const int commsOutPin = 7;
const int commsInPin = 8;
byte pcswitch = 0;
byte commsIn = 0;

int x = 64;
byte y = 16;
int timestamp = 0; //test mode
bool goingright = true;
bool goingup = true;
byte frame = 0;
byte screensaver; // 0 pro amogus, 1 pro čas a 2 pro datum
unsigned long milisAtStart;
int yearAtStart;
byte monthAtStart;
byte dayAtStart;
byte repeats;

void setup() {
  pinMode(pcswitchPin, OUTPUT);
  pinMode(localswitchPin, INPUT_PULLUP);
  pinMode(commsOutPin, OUTPUT);
  pinMode(commsInPin, INPUT_PULLUP);

  // SSD1306_SWITCHCAPVCC = generate display voltage from 3.3V internally
  if (!display.begin(SSD1306_SWITCHCAPVCC, SCREEN_ADDRESS)) {
    Serial.println(F("SSD1306 allocation failed"));
    for (;;); // Don't proceed, loop forever
  }

  // Clear the buffer
  display.clearDisplay();
  display.setTextColor(SSD1306_WHITE);

  // Draw a single pixel in white
  // display.drawPixel(10, 10, SSD1306_WHITE);

  // Show the display buffer on the screen. You MUST call display() after
  // drawing commands to make them visible on screen!

  // drawcustombitmap();
  drawSplash();
  display.display();

  Serial.begin(9600);
  Serial.write("Screen module");
  delay(1500);
  char rec[32];
  if (Serial.peek() == 'u') {
    Serial.read();
    switch (Serial.read()) {
      case 'a':
        screensaver = 0;
        // drawCenteredText("screensaver");

        break;
      case 't':
        screensaver = 1;
        // drawCenteredText("time");

        Serial.write("k");
        delay(2000);
        repeats = 0;
        while (Serial.available() > 0) {
          rec[repeats] = Serial.read();
          drawCenteredText(rec);
          delay(100);
          repeats++;
        }
        rec[repeats] = '\0';
        Serial.println("final value is " + String(atol(rec)));
        milisAtStart = (atol(rec) * 1000L) - millis();
        break;
      case 'd':
        screensaver = 2;
        // drawCenteredText("date");

        Serial.write('k');
        delay(2000);
        repeats = 0;
        while (Serial.available() > 0) {
          rec[repeats] = Serial.read();
          drawCenteredText(rec);
          delay(100);
          repeats++;
        }
        rec[repeats] = '\0';
        Serial.println("final value is " + String(atol(rec)));
        milisAtStart = (atol(rec) * 1000L) - millis();


        Serial.println("Clearing Serial buffer...");
        repeats = 0;
        while (Serial.available() > 0) {
          Serial.read();
          repeats++;
        }
        Serial.println("Cleared " + String(repeats) + " chars");

        delay(1000);
        Serial.write('k');
        delay(1000);

        while (Serial.available() < 1) {
          delay(0);
        }

        char incString[11];
        repeats = 0;
        while (Serial.available() > 0) {
          incString[repeats] = Serial.read();
          draw11pCenteredText(incString);
          delay(100);
          repeats++;
        }

        incString[repeats] = '\0';
        Serial.print("Date received as: " + String(incString));
        yearAtStart = atol(String(incString).substring(0, String(incString).indexOf('-')).c_str());
        monthAtStart = atol(String(incString).substring(String(incString).indexOf('-') + 1, String(incString).substring(String(incString).indexOf('-') + 1, String(incString).length()).indexOf('-')).c_str());
        dayAtStart = atol(String(incString).substring(String(incString).substring(String(incString).indexOf('-') + 1, String(incString).length()).indexOf('-'), String(incString).length()).c_str());
    }

  }
  else {
    // drawCenteredText("none");
  }

  delay(1000);

  // display.display() is NOT necessary after every single drawing command,
  // unless that's what you want...rather, you can batch up a bunch of
  // drawing operations and then update the screen all at once by calling
  // display.display(). These examples demonstrate both approaches...


  //TODO: drawcustomtext();

  //testdrawbitmap();    // Draw a small bitmap image

  //testdrawchar();      // Draw characters of the default font

  //testdrawstyles();    // Draw 'stylized' characters
  //digitalWrite(pcswitchPin, HIGH);
}

void loop() {
  display.clearDisplay();
  pcswitch = digitalRead(localswitchPin);
  // pcswitch = 0 if pushed, 1 if released

  if (pcswitch == 1) {
    if (frame > 80) frame = frame - 80;

    if (timestamp < 1000) {
      if (timestamp < 900) {
        display.clearDisplay();
        drawkris_inverted();
        display.display();
        /* original code
           display.setTextSize(2);
           display.setTextColor(SSD1306_WHITE);
           display.setCursor(32, 12);
           display.println(F("ready."));
           display.display();
        */
      } else {
        pcswitch = digitalRead(localswitchPin);
        drawCenteredText("standby");
        delay(10);
      }
      timestamp++;
    }
    else {
      if (screensaver == 1) {
        doClock();
      }
      else if (screensaver == 2) {
        doCalendar();
      }
      else {
        if (x > 117 || x < 1) {
          goingright = !goingright;
        }
        if (y > 21  || y < 1) {
          goingup    = !goingup;
        }

        if (goingright == true) {
          x = x + 1;
        } else {
          x = x - 1;
        }

        if (goingup == true) {
          y = y + 1;
        } else {
          y = y - 1;
        }

        display.clearDisplay();
        display.drawBitmap(x, y, amogus[frame % 6], 10, 10, WHITE);
        frame++;
        display.display();
        delay(30);
      }
    }



  } else {
    Serial.println("pushed");

    digitalWrite(pcswitchPin, HIGH);
    pcswitch = digitalRead(localswitchPin);
    while (pcswitch == 0) {
      drawCenteredText("henlo");
      delay(100);
      pcswitch = digitalRead(localswitchPin);
    }
    digitalWrite(pcswitchPin, LOW);
    commsIn = digitalRead(commsInPin);
    if (commsIn == 1) {
      // Not ready to play sound, show error message and continue
      frame = 0;
      while (frame < 7) {
        display.clearDisplay();
        display.drawBitmap(0, 0, notready[frame % 2], 128, 32, WHITE);
        display.display();
        delay(500);
        frame++;
      }
      frame = 0;
    }
    else {
      frame = 0;
      drawUnoAndNano();
      digitalWrite(commsOutPin, HIGH);
      while (commsIn == 0) {
        if (frame % 87 == 0) {
          frame = frame - 87;
          drawUnoAndNano();
        }
        display.drawPixel((frame % 87) + 22, 13, BLACK);
        display.drawPixel((frame % 87) + 23, 13, WHITE);
        display.drawPixel((frame % 87) + 24, 13, WHITE);
        display.drawPixel((frame % 87) + 25, 13, WHITE);
        display.display();

        frame++;
        commsIn = digitalRead(commsInPin);
      }
      // connection established, playing sound...
      digitalWrite(commsOutPin, LOW);
    }
    delay(250);

    drawCenteredText("gg, thx.");
    delay(1500);
    timestamp = 0;
  }

}

void drawSplash() {
  display.clearDisplay();
  display.drawBitmap(8, 0, big_chester, 33, 32, WHITE);
  display.drawBitmap(41, 11, che, 82, 13, WHITE);
  display.display();
  delay(750);

  for (int i = 0; i < 7; i++) {

    display.clearDisplay();
    display.drawBitmap(8, 0, big_chester, 33, 32, WHITE);
    display.drawBitmap(48, 15 + i, edupraha_only, 70, 8, WHITE);
    display.fillRect(41, 11 - i, 82, 14, BLACK);
    display.drawBitmap(41, 11 - i, che, 82, 13, WHITE);
    display.display();
    delay(100);
  }

  delay(1000);
}

void doClock() {
  long rnMilis = milisAtStart + millis();
  long rnSecs = rnMilis / 1000;
  long rnMins = rnSecs / 60;
  long rnHours = rnMins / 60;

  rnMilis = rnMilis % 1000;
  rnSecs = rnSecs % 60;
  rnMins = rnMins % 60;
  rnHours = rnHours % 24;

  drawCenteredText(noToDD(rnHours) + ":" + noToDD(rnMins) + ":" + noToDD(rnSecs));
}

void doCalendar() {
  {
    long rnMilis = milisAtStart + millis();
    long rnSecs = rnMilis / 1000;
    long rnMins = rnSecs / 60;
    long rnHours = rnMins / 60;

    byte rnDays = dayAtStart + rnHours / 24;
    byte rnMonth = monthAtStart;
    int rnYear = yearAtStart;


    // Arduino nedokáže udržet přesnej čas o moc dýl než 50 dní, takže
    // se nemůže stát, že by tenhle forloop nestačil. I tak jsem pro
    // jistotu použil 3x loop, aby nebyla ani majinkatá šance.
    for (int i = 0; i < 3; i++) {
      if (rnDays > 28) {
        switch (rnMonth) {
          case 1:
          case 3:
          case 5:
          case 7:
          case 8:
          case 10:
            if (rnDays > 31) {
              rnDays = rnDays - 31;
              rnMonth++;
            }
            break;
          case 4:
          case 6:
          case 9:
          case 11:
            if (rnDays > 30) {
              rnDays = rnDays - 30;
              rnMonth++;
            }
            break;
          case 2:
            if (rnDays > 28) {
              rnDays = rnDays - 28;
              rnMonth++;
            }
            break;
          case 12:
            if (rnDays > 31) {
              rnDays = rnDays - 31;
              rnMonth = 1;
              rnYear++;
            }
            break;
        }
      }
    }

    rnMilis = rnMilis % 1000;
    rnSecs = rnSecs % 60;
    rnMins = rnMins % 60;
    rnHours = rnHours % 24;

    draw11pCenteredText(noToDD(rnDays) + "." + noToDD(rnMonth) + "." + rnYear);
  }
}

String noToDD(long i) { // Double Digits
  if (i < 10)
    return "0" + String(i);
  else
    return String(i);
}

String noToTD(long i) { // Triple Digits
  if (i < 10)
    return "00" + String(i);
  else if (i < 100)
    return "0" + String(i);
  else
    return String(i);
}

void drawCenteredText(String str) {
  unsigned int width;
  unsigned int height;
  int curX;
  int curY;

  display.clearDisplay();
  display.setTextColor(SSD1306_WHITE);
  display.setFont(&__comic15pt7b);
  display.setTextSize(1);
  display.getTextBounds(str, 0, 0, &curX, &curY, &width, &height);  // na pozicích curX a curY to vrací souřadnice spodního levýho rohu, což nepotřebuju, ale ty pozice musej bejt vyplněný, tak používám něco, co pak hned přepíšu

  curX = 63 - (width / 2) ;
  curY = 15 + (height / 2)  ;

  if (millis() < 45000)
    Serial.println(str + ", " + String(width) + ", " + String(height) + ", " + String(curX) + ", " + String(curY));

  display.setCursor(curX, curY);
  display.println(str);
  display.display();

  display.setFont();
}

void draw11pCenteredText(String str) {
  unsigned int width;
  unsigned int height;
  int curX;
  int curY;

  display.clearDisplay();
  display.setTextColor(SSD1306_WHITE);
  display.setFont(&__comic11pt7b);
  display.getTextBounds(str, 0, 0, &curX, &curY, &width, &height);  // na pozicích curX a curY to vrací souřadnice spodního levýho rohu, což nepotřebuju, ale ty pozice musej bejt vyplněný, tak používám něco, co pak hned přepíšu

  curX = 63 - (width / 2) ;
  curY = 15 + (height / 2)  ;
  
 if (millis() < 45000)
  Serial.println(str + ", " + String(width) + ", " + String(height) + ", " + String(curX) + ", " + String(curY));

  display.setCursor(curX, curY);
  display.println(str);
  display.display();

  display.setFont();
}

void draw9pCenteredText(String str) {
  unsigned int width;
  unsigned int height;
  int curX;
  int curY;

  display.clearDisplay();
  display.setTextColor(SSD1306_WHITE);
  display.setFont(&__comic9pt7b);
  display.getTextBounds(str, 0, 0, &curX, &curY, &width, &height);  // na pozicích curX a curY to vrací souřadnice spodního levýho rohu, což nepotřebuju, ale ty pozice musej bejt vyplněný, tak používám něco, co pak hned přepíšu

  curX = 63 - (width / 2) ;
  curY = 15 + (height / 2)  ;
  
 if (millis() < 45000)
  Serial.println(str + ", " + String(width) + ", " + String(height) + ", " + String(curX) + ", " + String(curY));

  display.setCursor(curX, curY);
  display.println(str);
  display.display();

  display.setFont();
}

void drawlogoincorner(void) {
  display.drawBitmap(8, 0, big_chester, 33, 32, WHITE);
}

void drawcustombitmap(void) {
  display.drawBitmap(0, 0, myBitmaplogo, 128, 32, WHITE);
}

void drawkris(void) {
  display.drawBitmap(0, 0, god_dammit_kris, 128, 32, WHITE);
}

void drawkris_inverted(void) {
  display.drawBitmap(0, 0, god_dammit_kris_inverted, 128, 32, WHITE);
}

/* UNUSED CODE
  void testdrawbitmap(void) {
  display.clearDisplay();

  display.drawBitmap(
    (display.width()  - LOGO_WIDTH ) / 2,
    (display.height() - LOGO_HEIGHT) / 2,
    logo_bmp, LOGO_WIDTH, LOGO_HEIGHT, 1);
  display.display();
  delay(1000);
  }
*/

void testdrawchar(void) {
  display.clearDisplay();

  display.setTextSize(1);      // Normal 1:1 pixel scale
  display.setTextColor(SSD1306_WHITE); // Draw white text
  display.setCursor(0, 0);     // Start at top-left corner
  display.cp437(true);         // Use full 256 char 'Code Page 437' font

  // Not all the characters will fit on the display. This is normal.
  // Library will draw what it can and the rest will be clipped.
  for (int16_t i = 0; i < 256; i++) {
    if (i == '\n') display.write(' ');
    else          display.write(i);
  }

  display.display();
  delay(2000);
}

void drawUnoAndNano() {
  display.clearDisplay();
  display.drawBitmap(7, 4, uno, 15, 17, WHITE);
  display.drawBitmap(110, 4, nano, 11, 18, WHITE);
  display.setTextSize(1);
  display.setCursor(18, 24);
  display.println(F("contacting nano"));
  display.drawPixel(108, 30, WHITE);
  display.drawPixel(110, 30, WHITE);
  display.drawPixel(112, 30, WHITE);
  display.display();
}

void testdrawstyles(void) {
  display.clearDisplay();

  display.setTextSize(1);             // Normal 1:1 pixel scale
  display.setTextColor(SSD1306_WHITE);        // Draw white text
  display.setCursor(0, 0);            // Start at top-left corner
  display.println(F("Hello, world!"));

  display.setTextColor(SSD1306_BLACK, SSD1306_WHITE); // Draw 'inverse' text
  display.println(3.141592);

  display.setTextSize(2);             // Draw 2X-scale text
  display.setTextColor(SSD1306_WHITE);
  display.print(F("0x")); display.println(0xDEADBEEF, HEX);

  display.display();
  delay(2000);
}
